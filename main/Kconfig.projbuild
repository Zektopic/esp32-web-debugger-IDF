## main/Kconfig.projbuild
```kconfig
menu "ESP32 Web Debugger"

    config WEBDBG_ENABLE_WIFI
        bool "Enable Wi-Fi and the web UI"
        depends on SOC_WIFI_SUPPORTED
        default y
        help
            Disable to build a headless firmware (benchmarks can still be run
            at boot, see "Run all benchmarks at boot").

    menu "Wi-Fi"
        depends on WEBDBG_ENABLE_WIFI

        config ESP_WIFI_SSID
            string "Station SSID (network to join)"
            default ""
            help
                SSID of the router the ESP32 should join. Leave empty to run
                in access-point-only mode.

        config ESP_WIFI_PASSWORD
            string "Station password"
            default ""
            help
                Password (WPA/WPA2/WPA3) of the network above.

        config WEBDBG_AP_SSID
            string "Access point SSID"
            default "ESP32-Debugger"

        config WEBDBG_AP_PASSWORD
            string "Access point password"
            default "12345678"
            help
                Must be at least 8 characters, otherwise the access point is open.

        config WEBDBG_AP_CHANNEL
            int "Access point channel"
            range 1 13
            default 1

        config WEBDBG_AP_MAX_CONN
            int "Access point max stations"
            range 1 10
            default 4
    endmenu

    menu "Bus pins"

        config WEBDBG_UART_TX_GPIO
            int "UART1 TX GPIO"
            default 17 if IDF_TARGET_ESP32
            default 4  if IDF_TARGET_ESP32S2
            default 17 if IDF_TARGET_ESP32S3
            default 6  if IDF_TARGET_ESP32C3
            default 4
            help
                UART used by the web UART terminal and the UART loopback benchmark.
                These pins are removed from the GPIO grid.

        config WEBDBG_UART_RX_GPIO
            int "UART1 RX GPIO"
            default 16 if IDF_TARGET_ESP32
            default 5  if IDF_TARGET_ESP32S2
            default 18 if IDF_TARGET_ESP32S3
            default 7  if IDF_TARGET_ESP32C3
            default 5

        config WEBDBG_I2C_SDA_GPIO
            int "I2C SDA GPIO"
            default 21 if IDF_TARGET_ESP32
            default 8  if IDF_TARGET_ESP32S2
            default 8  if IDF_TARGET_ESP32S3
            default 4  if IDF_TARGET_ESP32C3
            default 6

        config WEBDBG_I2C_SCL_GPIO
            int "I2C SCL GPIO"
            default 22 if IDF_TARGET_ESP32
            default 9  if IDF_TARGET_ESP32S2
            default 9  if IDF_TARGET_ESP32S3
            default 5  if IDF_TARGET_ESP32C3
            default 7
    endmenu

    menu "Benchmarks"

        config WEBDBG_BENCH_RUN_ON_BOOT
            bool "Run all benchmarks at boot"
            default y if !SOC_WIFI_SUPPORTED
            default n
            help
                Runs the full suite once after start-up and prints a
                machine readable "BENCH_RESULT {json}" line per benchmark on
                the serial console. Always on for chips without Wi-Fi.

        config WEBDBG_BENCH_LED_GPIO
            int "GPIO of a plain LED used by the LED benchmark (-1 = none)"
            default 2 if IDF_TARGET_ESP32
            default -1
            help
                Can also be changed at run time from the web UI.

        config WEBDBG_BENCH_RGB_GPIO
            int "GPIO of an addressable (WS2812) LED (-1 = none)"
            default 48 if IDF_TARGET_ESP32S3
            default 18 if IDF_TARGET_ESP32S2
            default 8  if IDF_TARGET_ESP32C3
            default 8  if IDF_TARGET_ESP32C6
            default -1
            help
                Typical on-board RGB LED pin of the official dev kits.
                Can also be changed at run time from the web UI.
    endmenu

endmenu
```
